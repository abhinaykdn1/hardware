/*
 * lcd_PCD8544.c
 *
 *  Created on: Oct 3, 2013
 *      Author: lim
 */

#include "lcd_PCD8544.h"
#include <avr/io.h>
#include <util/delay.h>

const unsigned char PROGMEM font5x7 [][CHAR_WIDTH - 1] = {
	    { 0x00, 0x00, 0x00, 0x00, 0x00 },   //
	    { 0x00, 0x00, 0x2f, 0x00, 0x00 },   // !
	    { 0x00, 0x07, 0x00, 0x07, 0x00 },   // "
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		{ 0xFF, 0xFF, 0xFF, 0xFF, 0xFF },   // Cursor // ~
};

unsigned char text_buf[LCD_CHARS];

unsigned char chr_pos = 0;
unsigned int curr_addr = 0;

void lcd_send_cmd(unsigned char data)
{
	CLRP(LCD_CE);
	CLRP(LCD_DC); //0 for command, 1 for data
	for (unsigned char i=0; i<8; i++) {
		if ((data>>(7-i)) & 0x01) {
			SETP(LCD_DIN);
		} else {
			CLRP(LCD_DIN);
		}

		// Toggle the clock
		CLRP(LCD_CLK);
		SETP(LCD_CLK);
	}
	SETP(LCD_CE);
}

void lcd_send_data(unsigned char data)
{
	CLRP(LCD_CE);
	SETP(LCD_DC); //0 for command, 1 for data
	for (unsigned char i=0; i<8; i++) {
		if ((data>>(7-i)) & 0x01) {
			SETP(LCD_DIN);
		} else {
			CLRP(LCD_DIN);
		}

		// Toggle the clock
		CLRP(LCD_CLK);
		SETP(LCD_CLK);
	}
	SETP(LCD_CE);
}

void lcd_base_addr(unsigned int addr) {
	lcd_send_cmd(0x80 |(addr % LCD_WIDTH));
	lcd_send_cmd(0x40 |(addr / LCD_WIDTH));
}

void lcd_clear(void)
{
	int lcd_size =  ((LCD_WIDTH * LCD_HEIGHT) / CHAR_HEIGHT);

    for (int i=0; i<lcd_size; i++) {
    	lcd_send_data(0x00);
    }
}

void lcd_fill(void)
{
	int lcd_size =  ((LCD_WIDTH * LCD_HEIGHT) / CHAR_HEIGHT);

    for (int i=0; i<lcd_size; i++) {
    	lcd_send_data(0xFF);
    }
}

//void lcd_rand(void)
//{
//	int lcd_size =  ((LCD_WIDTH * LCD_HEIGHT) / CHAR_HEIGHT);
//
//    for (int i=0; i<lcd_size; i++) {
//    	lcd_send_data(rand() & 0xFF);
//    }
//}

void lcd_chr(unsigned char chr)
{
	char out_char = chr>31?(chr<128?chr:32):32;
	lcd_base_addr(curr_addr);
	for(unsigned char i=0; i < CHAR_WIDTH - 1; i++) {
		lcd_send_data(pgm_read_byte(&font5x7[out_char-32][i]) << 1);
		curr_addr++;
	}
	lcd_send_data(0);
	curr_addr++;
	curr_addr = curr_addr % LCD_BYTES;
}

void lcd_refresh_text()
{
	curr_addr = 0;
	for (unsigned char i = 0; i < LCD_CHARS; i++) {
		lcd_chr(text_buf[i]);
	}
}

void lcd_char_scroll()
{
	for (unsigned char i = 0; i < LCD_CHARS - LCD_COLS; i++) {
		text_buf[i] = text_buf[i + LCD_COLS];
	}
	for (unsigned char i = LCD_CHARS - LCD_COLS; i < LCD_CHARS; i++) {
		text_buf[i] = 0;
	}
	lcd_refresh_text();
	chr_pos = LCD_CHARS - LCD_COLS;
}

void lcd_putchr(unsigned char chr)
{
	curr_addr = chr_pos * CHAR_WIDTH;
	if (chr != '\n') {
		text_buf[chr_pos++] = chr;
		lcd_chr(chr);
	} else {
		lcd_chr(text_buf[chr_pos]);
		unsigned char new_chr_pos = chr_pos - (chr_pos % LCD_COLS) + LCD_COLS;
		for (; chr_pos<new_chr_pos; chr_pos++) {
			text_buf[chr_pos] = 0;
		}
	}
	if (chr_pos>=LCD_CHARS) {
		lcd_char_scroll();
	}
	curr_addr = chr_pos * CHAR_WIDTH;
	lcd_chr(127);
//	chr_pos = chr_pos % LCD_CHARS;
}

void lcd_str(char *str)
{
    while (*str) {
    	lcd_putchr(*str++);
//    	_delay_ms(50)
    }
}

/*
// displays a formated string, similar to printf
void lcd_string_format(char *szFormat, ...)
{
	char szBuffer[256]; //in this buffer we form the message
	int NUMCHARS = sizeof(szBuffer) / sizeof(szBuffer[0]);
	int LASTCHAR = NUMCHARS - 1;
	va_list pArgs;
	va_start(pArgs, szFormat);
	vsnprintf(szBuffer, NUMCHARS - 1, szFormat, pArgs);
	va_end(pArgs);

	lcd_str(szBuffer);
}
*/

void lcd_init(void)
{
	SETP(LCD_RST);
	SETD(LCD_RST);

	SETD(LCD_CE);
	SETD(LCD_DC);
	SETD(LCD_DIN);
	SETD(LCD_CLK);

	_delay_ms(15);
	CLRP(LCD_RST);
	_delay_ms(64);
	SETP(LCD_RST);
	SETP(LCD_CE);

    lcd_send_cmd(0x21);  // LCD Extended Commands
    lcd_send_cmd(0xC8);  // Set LCD Vop(Contrast)
    lcd_send_cmd(0x06);  // Set Temp coefficent
    lcd_send_cmd(0x13);  // LCD bias mode 1:48
    lcd_send_cmd(0x20);  // Standard Commands, Horizontal addressing
    lcd_send_cmd(0x0C);  // LCD in normal mode

    lcd_clear();

	int contrast = 0x3A;
	lcd_send_cmd(0x21);				// LCD Extended Commands
	lcd_send_cmd(0x80 | contrast);	// Set LCD Vop(Contrast)
	lcd_send_cmd(0x20);				// LCD std cmds, hori addr mode

}


